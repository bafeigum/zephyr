/*
 * SPDX-License-Identifier: Apache-2.0
 */

/dts-v1/;

#include <bit_riscv.dtsi>

/ {
	model = "bit_riscv 1";
	compatible = "bit_riscv,bit_riscv1";
	aliases {
	};

	chosen {
		zephyr,console = &uart0;
	};
};

&uart0 {
	status = "ok";
	current-speed = <115200>;
	clock-frequency = <66000000>;
};
