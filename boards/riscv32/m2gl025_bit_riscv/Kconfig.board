## boards/riscv32/m2gl025_bit_riscv/Kconfig.board
```kconfig
config BOARD_M2GL025_BIT_RISCV
	bool "Microsemi M2GL025 IGLOO2 dev board with bit_riscv CPU"
	depends on SOC_RISCV32_BIT_RISCV
```

## boards/riscv32/m2gl025_bit_riscv/m2gl025_bit_riscv_defconfig
```kconfig
CONFIG_RISCV32=y
CONFIG_SOC_RISCV32_BIT_RISCV=y
CONFIG_BOARD_M2GL025_BIT_RISCV=y
CONFIG_CONSOLE=y
CONFIG_SERIAL=y
CONFIG_UART_MIV=y
CONFIG_UART_MIV_PORT_0=y
CONFIG_UART_CONSOLE=y
CONFIG_PLIC=n
CONFIG_RISCV_MACHINE_TIMER=y
CONFIG_GPIO=n
CONFIG_XIP=n
```

## dts/bindings/serial/microsemi,mssuart.yaml
```yaml
#
#
# SPDX-License-Identifier: Apache-2.0
#
---
title: MSS UART
version: 0.1

description: >
    This binding gives a base representation of the MSS UART

inherits:
    !include uart.yaml

properties:
    compatible:
      type: string
      category: required
      description: compatible strings
      constraint: "microsemi,mssuart"
      generation: define

    reg:
      type: array
      description: mmio register space
      generation: define
      category: required

    interrupts:
      type: array
      category: required
      description: required interrupts
      generation: define

...
```

## soc/riscv32/riscv-privilege/bit_riscv/Kconfig.defconfig.series
```kconfig
if SOC_SERIES_RISCV32_BIT_RISCV

config SOC_SERIES
	string
	default "bit_riscv"

config SYS_CLOCK_HW_CYCLES_PER_SEC
	int
	default 660000

config RISCV_SOC_INTERRUPT_INIT
	bool
	default n

config RISCV_HAS_CPU_IDLE
	bool
	default n

config RISCV_HAS_PLIC
	bool
	default n

config NUM_IRQS
	int
	default 42

config XIP
	bool
	default n

config RISCV_ROM_BASE_ADDR
	hex
	default 0x20000000

config RISCV_ROM_SIZE
	hex
	default 0x05000

config RISCV_RAM_BASE_ADDR
	hex
	default	0x20005000

config RISCV_RAM_SIZE
	hex
	default 0x08000

endif # SOC_SERIES_RISCV32_BIT_RISCV
```

## soc/riscv32/riscv-privilege/bit_riscv/Kconfig.series
```kconfig
# Kconfig - RISCV32_BIT_RISCV implementation
#
#

config SOC_SERIES_RISCV32_BIT_RISCV
	bool "bit_riscv implementation"
	depends on RISCV32
	select SOC_FAMILY_RISCV_PRIVILEGE
	help
	Enable support for bit_riscv
```

## soc/riscv32/riscv-privilege/bit_riscv/Kconfig.soc
```kconfig
# Kconfig - RISCV32_BIT_RISCV configuration options
#
#

choice
prompt "bit_riscv system implementation"
depends on SOC_SERIES_RISCV32_BIT_RISCV

config SOC_RISCV32_BIT_RISCV
	bool "bit_riscv system implementation"

endchoice
```
